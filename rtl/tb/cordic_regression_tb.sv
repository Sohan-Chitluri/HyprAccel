`timescale 1ns/1ps

// Exact-output regression for the fixed 16-bit Q4.12, 8-stage CORDIC core.
// Vectors are generated by reference/cordic_golden/cordic_golden.py.
module cordic_regression_tb;
  logic clk = 1'b0;
  logic rst_n = 1'b0;
  logic signed [15:0] x_in, y_in, z_in;
  logic valid_in, ready_out;
  logic [3:0] cfg_iterations;
  logic cfg_saturate, config_valid, config_ready;
  logic signed [15:0] x_out, y_out, z_out;
  logic valid_out, ready_in, overflow, irq;
  integer fd, vector_count, index, scan_count, errors;
  integer xi, yi, zi, sat, expected_x, expected_y, expected_z, expected_overflow;

  cordic_top dut (
    .clk, .rst_n, .x_in, .y_in, .z_in, .valid_in, .ready_out,
    .cfg_iterations, .cfg_saturate, .config_valid, .config_ready,
    .x_out, .y_out, .z_out, .valid_out, .ready_in, .overflow, .irq
  );

  always #5 clk = ~clk;

  task automatic apply_config(input logic saturate);
    begin
      @(negedge clk);
      cfg_saturate = saturate;
      config_valid = 1'b1;
      @(negedge clk);
      config_valid = 1'b0;
    end
  endtask

  task automatic send_vector(input integer in_x, input integer in_y, input integer in_z);
    begin
      while (!ready_out) @(negedge clk);
      x_in = in_x[15:0];
      y_in = in_y[15:0];
      z_in = in_z[15:0];
      valid_in = 1'b1;
      @(negedge clk);
      valid_in = 1'b0;
    end
  endtask

  task automatic check_output(
    input integer vector_id, input integer ex, input integer ey, input integer ez, input integer eovf
  );
    integer wait_cycles;
    begin
      wait_cycles = 0;
      while (!valid_out && wait_cycles < 16) begin
        @(negedge clk);
        wait_cycles++;
      end
      if (!valid_out) begin
        if (errors < 10) $display("FAIL vector %0d: timeout waiting for valid_out", vector_id);
        errors++;
      end else if ((x_out !== ex[15:0]) || (y_out !== ey[15:0]) ||
                   (z_out !== ez[15:0]) || (overflow !== eovf[0])) begin
        if (errors < 10)
          $display("FAIL vector %0d: got x=%0d y=%0d z=%0d ovf=%0b; expected x=%0d y=%0d z=%0d ovf=%0d",
                   vector_id, x_out, y_out, z_out, overflow, ex, ey, ez, eovf);
        errors++;
      end
      @(negedge clk);
    end
  endtask

  initial begin
    x_in = '0; y_in = '0; z_in = '0;
    valid_in = 1'b0; ready_in = 1'b1;
    cfg_iterations = 4'd8; cfg_saturate = 1'b1; config_valid = 1'b0;
    errors = 0;

    repeat (3) @(posedge clk);
    rst_n = 1'b1;
    repeat (2) @(negedge clk);

    fd = $fopen("build/regression.mem", "r");
    if (fd == 0) $fatal(1, "could not open build/regression.mem");
    scan_count = $fscanf(fd, "%d\n", vector_count);
    if (scan_count != 1) $fatal(1, "could not read vector count");

    for (index = 0; index < vector_count; index++) begin
      scan_count = $fscanf(fd, "%d %d %d %d %d %d %d %d\n",
                           xi, yi, zi, sat, expected_x, expected_y, expected_z, expected_overflow);
      if (scan_count != 8) $fatal(1, "could not read vector %0d", index);
      apply_config(sat[0]);
      send_vector(xi, yi, zi);
      check_output(index, expected_x, expected_y, expected_z, expected_overflow);
    end
    $fclose(fd);

    if (errors != 0) $fatal(1, "FAIL: %0d/%0d regression vectors mismatched", errors, vector_count);
    $display("PASS: %0d CORDIC regression vectors matched exactly", vector_count);
    $finish;
  end
endmodule
